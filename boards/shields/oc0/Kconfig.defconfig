## boards/shields/oc0/Kconfig.defconfig
```kconfig
if SHIELD_OC0_LEFT

# Name must be less than 16 characters long!
config ZMK_KEYBOARD_NAME
    default "OC0"

config ZMK_SPLIT_ROLE_CENTRAL
    default y

config ZMK_SPLIT_BLE_CENTRAL_PERIPHERALS
  default 1

config BT_MAX_CONN
  default 6

config BT_MAX_PAIRED
  default 6

endif

if SHIELD_OC0_LEFT || SHIELD_OC0_RIGHT

config ZMK_SPLIT
    default y

endif
```

## boards/shields/oc0/Kconfig.shield
```kconfig
config SHIELD_OC0_LEFT
    def_bool $(shields_list_contains,oc0_left)
  
config SHIELD_OC0_RIGHT
    def_bool $(shields_list_contains,oc0_right)
  
```
